## CMakeLists.txt
```
cmake_minimum_required(VERSION 3.20.0)

find_package(Python COMPONENTS Interpreter REQUIRED)

set(PW_DIR "${CMAKE_CURRENT_LIST_DIR}/../third_party/pigweed")
include("${PW_DIR}/pw_build/pigweed.cmake")
include("${PW_DIR}/pw_trace/backend.cmake")
include("${PW_DIR}/pw_protobuf_compiler/proto.cmake")

if("${dir_pw_third_party_nanopb}" STREQUAL "")
  set(dir_pw_third_party_nanopb "${CMAKE_CURRENT_LIST_DIR}/../third_party/nanopb" CACHE PATH "" FORCE)
endif()

# One time setup: Zephyr does some strange handling of nanopb by linking the
# sources directly into Zephyr instead of creating a static library which we
# can depend on, so we need to create a fake target to keep the linker happy.
add_library(protobuf-nanopb INTERFACE)
add_compile_definitions(PW_SYSTEM_ENABLE_TRACE_SERVICE=1)
add_compile_definitions(PW_SYSTEM_ENABLE_TRANSFER_SERVICE=0)
pw_set_backend(pw_trace pw_trace_tokenized)

# Add the token database builder BEFORE adding the Zephyr package, otherwise it will not be picked
# up by the build system.
set_property(GLOBAL APPEND PROPERTY extra_post_build_commands
  COMMAND
    ${Python_EXECUTABLE}
    -m pw_tokenizer.database
    create
    --force
    --type binary
    -d ${CMAKE_BINARY_DIR}/tokendatabase.bin
    ${CMAKE_BINARY_DIR}/zephyr/zephyr_pre0.elf
)

find_package(Zephyr REQUIRED HINTS $ENV{ZEPHYR_BASE})
project(zig2025)

add_subdirectory(di)
add_subdirectory(rpc)

target_sources(app
  PRIVATE
    src/main.cc
)

target_link_libraries(app PRIVATE
  zig2025_di
  zig2025_service
)
```

## prj.conf
```kconfig
# Build
# =====
# CONFIG_KCONFIG_WARNINGS_AS_ERRORS=y

# Boot banner
# ===========
CONFIG_BOOT_BANNER=n

# C++ support
# ===========
CONFIG_CPP=y
CONFIG_STD_CPP20=y
CONFIG_REQUIRES_FULL_LIBCPP=y

# Synchronization
# ===============
CONFIG_PIGWEED_SYNC_INTERRUPT_SPIN_LOCK=y

# Asserts
# =======
CONFIG_ASSERT=y
CONFIG_PIGWEED_ASSERT=y

# RPC
# ===
CONFIG_NANOPB=y
CONFIG_PIGWEED_RPC_SERVER=y
CONFIG_PIGWEED_CHRONO_SYSTEM_TIMER=y

# Logging
# =======
CONFIG_LOG=y
CONFIG_SHELL=y
CONFIG_PIGWEED_SYS_IO=y
CONFIG_CONSOLE_SUBSYS=y
CONFIG_CONSOLE_GETCHAR=y
CONFIG_CONSOLE_GETCHAR_BUFSIZE=128
CONFIG_CONSOLE_PUTCHAR_BUFSIZE=128
CONFIG_PIGWEED_LOG_TOKENIZED_RPC=y
```

## boards/robokit1.overlay
```dts
#include "zephyr/dt-bindings/gpio/gpio.h"

/ {
    interrupt-loop {
        compatible = "zig2025,gpio-loop";
        in-gpios = <&piod 11 (GPIO_ACTIVE_HIGH)>;
        out-gpios = <&piod 10 (GPIO_ACTIVE_HIGH)>;
    };
};
```

## boards/rpi_pico.overlay
```dts
#include "zephyr/dt-bindings/gpio/gpio.h"

/ {
    interrupt-loop {
        compatible = "zig2025,gpio-loop";
        in-gpios = <&gpio0 1 (GPIO_ACTIVE_HIGH)>;
        out-gpios = <&gpio0 2 (GPIO_ACTIVE_HIGH)>;
    };
};
```

## dts/bindings/gpio-loop.yaml
```yaml
description: GPIO output pin and input pin pair

compatible: "zig2025,gpio-loop"

properties:
  in-gpios:
    type: phandle-array
    required: true
    description: |
      The GPIO connected as an input.
  out-gpios:
    type: phandle-array
    required: true
    description: |
      The GPIO connected as an output.
```

## src/main.cc
```c
#define PW_LOG_MODULE_NAME "main"

#include "pw_log/log.h"
#include "pw_system/init.h"
#include "pw_system/rpc_server.h"
#include "zig2025/di/app.h"

int main() {
  pw::system::Init();
  PW_LOG_INFO("Hello ZiG-2025!");
  return 0;
}
```
